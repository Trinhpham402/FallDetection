## firmware/wifi_csi_rx/sdkconfig.defaults
```kconfig
CONFIG_ESP_WIFI_CSI_ENABLED=y
CONFIG_APP_MIN_CSI_INTERVAL_MS=0
CONFIG_APP_QUEUE_DEPTH=128
```

## firmware/wifi_csi_tx/main/Kconfig.projbuild
```kconfig
menu "CSI probe transmitter"
config APP_WIFI_SSID
    string "Wi-Fi SSID"
    default ""
config APP_WIFI_PASSWORD
    string "Wi-Fi password (empty for open AP)"
    default ""
config APP_WIFI_CHANNEL
    int "Expected 2.4 GHz channel"
    range 1 13
    default 6
config APP_TX_INTERVAL_MS
    int "Probe interval (ms)"
    range 10 60000
    default 10
    help
        Local ESP-Fi-HAR collection target: 100 probes/s. Measure actual CSI
        throughput on each RX; this is not a guarantee of 100 received samples/s.
endmenu
```

## firmware/wifi_csi_tx/sdkconfig.defaults
```kconfig
CONFIG_IDF_TARGET="esp32s3"
CONFIG_FREERTOS_HZ=1000
CONFIG_APP_TX_INTERVAL_MS=10
```

## wifi_csi_rx/main/Kconfig.projbuild
```kconfig
menu "CSI receiver"
config APP_RX_NODE_ID
    int "RX node ID"
    range 1 2
    default 1
config APP_WIFI_SSID
    string "Wi-Fi SSID"
    default ""
config APP_WIFI_PASSWORD
    string "Wi-Fi password"
    default ""
config APP_WIFI_CHANNEL
    int "Expected AP and TX channel"
    range 1 13
    default 6
config APP_SERVER_IP
    string "Collector IPv4"
    default "192.168.1.100"
config APP_SERVER_PORT
    int "Collector UDP port"
    range 1 65535
    default 5005
config APP_TX_MAC
    string "TX STA MAC (required)"
    default "00:00:00:00:00:00"
config APP_MIN_CSI_INTERVAL_MS
    int "Minimum CSI interval (ms; 0 disables throttle)"
    range 0 60000
    default 0
    help
        Keep zero for the 100 Hz collection target. A positive interval can
        discard CSI and is checked again by the host exporter.
config APP_QUEUE_DEPTH
    int "Packet queue depth"
    range 4 256
    default 128
endmenu
```
